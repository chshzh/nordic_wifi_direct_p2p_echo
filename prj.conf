## CMakeLists.txt
```
#
# Copyright (c) 2026 Nordic Semiconductor ASA
#
# SPDX-License-Identifier: LicenseRef-Nordic-5-Clause
#

cmake_minimum_required(VERSION 3.20.0)

find_package(Zephyr REQUIRED HINTS $ENV{ZEPHYR_BASE})
project(wifi_direct_p2p_echo)

# Source files
target_sources(app PRIVATE
    src/main.c
    src/wifi_p2p_utils.c
    src/net_utils.c
    src/udp_utils.c
)
```

## Kconfig
```
#
# Copyright (c) 2026 Nordic Semiconductor ASA
#
# SPDX-License-Identifier: LicenseRef-Nordic-5-Clause
#

source "Kconfig.zephyr"

menu "Nordic Wi-Fi Direct P2P Echo"

config P2P_TARGET_PEER_MAC
	string "Target P2P Peer MAC Address (filter)"
	default ""
	help
	  Set the target peer MAC address to connect to.
	  Format: "xx:xx:xx:xx:xx:xx" (lowercase hex with colons).
	  Leave empty to connect to any discovered peer.
	  Example: Set to "f4:ce:36:00:af:12" on client to only connect
	  to the GO with that MAC address.

config P2P_GO_INTENT
	int "P2P GO Intent (0-15)"
	range 0 15
	default 15
	help
	  Set the Group Owner (GO) intent value.
	  Higher values indicate higher willingness to become GO.
	  - 15: Always become GO
	  - 0: Always become Client
	  - 1-14: Negotiated based on peer's intent

config P2P_DISCOVERY_TIMEOUT
	int "P2P Discovery Timeout (seconds)"
	default 30
	help
	  Set the timeout for P2P device discovery.
	  0 means no timeout (run until stopped).

config P2P_DISCOVERY_WAIT_MS
	int "P2P Discovery Wait Timeout (milliseconds)"
	default 10000
	help
	  Maximum time to wait for initial peer discovery before
	  checking the peer list. The discovery continues in background.

config P2P_FIND_STOP_DELAY_MS
	int "P2P Find Stop Delay (milliseconds)"
	default 500
	help
	  Delay after stopping P2P find before initiating connection.
	  This mirrors the wifi shell flow where P2P-FIND-STOPPED is
	  observed before starting GO negotiation.

config P2P_GO_NEG_REQUEST_WAIT_MS
	int "GO Negotiation Request Wait (milliseconds)"
	default 3000
	help
	  Time for the CLI to wait for the GO negotiation request before
	  initiating wifi p2p connect as Client.

config P2P_GROUP_FORMATION_TIMEOUT_MS
	int "P2P Group Formation Timeout (milliseconds)"
	default 30000
	help
	  Maximum time to wait for P2P group formation (GO negotiation
	  and group setup). Increase if connection is slow.

config P2P_AP_STA_CONNECTED_TIMEOUT_MS
	int "AP-STA-CONNECTED Wait Timeout (milliseconds)"
	default 30000
	help
	  Maximum time the GO waits for AP-STA-CONNECTED before
	  configuring IP and starting DHCP server.

config P2P_4WAY_HANDSHAKE_WAIT_MS
	int "4-Way Handshake Wait (milliseconds)"
	default 1500
	help
	  Delay after AP-STA-CONNECTED to allow EAPOL 4-way handshake
	  to complete before starting DHCP server.

config P2P_DHCP_TIMEOUT_MS
	int "DHCP Timeout for Client (milliseconds)"
	default 10000
	help
	  Maximum time for the P2P Client to wait for DHCP IP assignment
	  from the Group Owner.

config P2P_DHCP_START_DELAY_MS
	int "DHCP Client Start Delay (milliseconds)"
	default 5000
	help
	  Delay before starting DHCP client on the P2P Client device.
	  This gives the Group Owner time to configure its IP and start
	  the DHCP server. Without this delay, the client may send DHCP
	  requests before the server is ready, causing long retry delays.

config P2P_CLIENT_CONNECT_DELAY_MS
	int "Client Connect Delay (milliseconds)"
	default 2000
	help
	  Delay after getting IP address before starting UDP client.
	  This gives the GO time to start its echo server.

config P2P_OPERATING_CHANNEL
	int "P2P Operating Channel"
	default 11
	help
	  Set the preferred Wi-Fi channel for P2P group operation.
	  Channel 11 (2462 MHz) is commonly used for P2P.

config P2P_OPERATING_FREQUENCY
	int "P2P Operating Frequency (MHz)"
	default 2462
	help
	  Set the preferred frequency in MHz for P2P group operation.
	  2462 MHz corresponds to channel 11 in 2.4 GHz band.

choice P2P_CONNECTION_METHOD
	prompt "P2P Connection Method"
	default P2P_METHOD_PBC

config P2P_METHOD_PBC
	bool "Push Button Configuration (PBC)"
	help
	  Use Push Button Configuration for P2P connection.
	  This is the simplest method - just press button on both devices.

config P2P_METHOD_DISPLAY
	bool "Display PIN"
	help
	  Display a PIN that the peer device needs to enter.

config P2P_METHOD_KEYPAD
	bool "Keypad PIN"
	help
	  Enter a PIN that is displayed on the peer device.
endchoice

config P2P_DHCP_SERVER_POOL_START
	string "DHCP Server Pool Start Address"
	default "192.168.88.10"
	help
	  Set the start IP address of the DHCP pool when acting as GO.

config P2P_GO_IP_ADDRESS
	string "GO IP Address"
	default "192.168.88.1"
	help
	  Set the IP address for the Group Owner.

config P2P_GO_IP_NETMASK
	string "GO IP Netmask"
	default "255.255.255.0"
	help
	  Set the netmask for the P2P group network.

config P2P_SAMPLE_START_WIFI_THREAD_STACK_SIZE
	int "Stack size for Wi-Fi start thread"
	default 5200
	help
	  Set the stack size for the Wi-Fi start thread.

config P2P_REG_DOMAIN
	string "Regulatory Domain (ISO/IEC alpha2 country code)"
	default "00"
	help
	  Set the regulatory domain country code.
	  Use "00" for world regulatory.

menu "UDP Echo Demo Configuration"

config UDP_ECHO_PORT
	int "UDP Echo Port"
	default 5001
	help
	  Set the UDP port for the echo server/client.

config UDP_ECHO_INTERVAL_MS
	int "UDP Packet Send Interval (ms)"
	default 1000
	help
	  Set the interval between UDP packet transmissions in milliseconds.

config UDP_ECHO_PACKET_SIZE
	int "UDP Packet Size (bytes)"
	default 64
	range 16 1024
	help
	  Set the size of UDP packets to send.

config UDP_ECHO_COUNT
	int "Number of UDP Echo Packets (0 = infinite)"
	default 0
	help
	  Set the number of UDP packets to send.
	  0 means send continuously until stopped.

endmenu

endmenu
```

## west.yml
```
# Copyright (c) 2026 Nordic Semiconductor ASA
# SPDX-License-Identifier: LicenseRef-Nordic-5-Clause

manifest:
  version: "1.0"

  self:
    path: nordic_wifi_direct_p2p_echo

  remotes:
    - name: ncs
      url-base: https://github.com/nrfconnect
    - name: chshzh
      url-base: https://github.com/chshzh

  projects:
    - name: sdk-nrf
      remote: ncs
      revision: main
      import: true
```

## prj.conf
```kconfig
#
# Copyright (c) 2026 Nordic Semiconductor ASA
#
# SPDX-License-Identifier: LicenseRef-Nordic-5-Clause
#

# Wi-Fi driver
CONFIG_WIFI=y
CONFIG_WIFI_NRF70=y

# Wi-Fi P2P support
CONFIG_NRF70_P2P_MODE=y
CONFIG_NRF70_AP_MODE=y
CONFIG_WIFI_NM_WPA_SUPPLICANT=y
CONFIG_WIFI_NM_WPA_SUPPLICANT_P2P=y
CONFIG_WIFI_NM_WPA_SUPPLICANT_AP=y
CONFIG_WIFI_NM_WPA_SUPPLICANT_WPS=y
CONFIG_WIFI_NM_WPA_SUPPLICANT_EAPOL=y
CONFIG_WIFI_NM_WPA_SUPPLICANT_INF_MON=y
CONFIG_WIFI_NM_WPA_SUPPLICANT_GLOBAL_HEAP=y

# DHCP Server for GO role
CONFIG_NET_DHCPV4_SERVER=y

# Disable low power for stable P2P operation
CONFIG_NRF_WIFI_LOW_POWER=n

# Wi-Fi ready library for safe initialization
CONFIG_WIFI_READY_LIB=y

# Networking
CONFIG_NETWORKING=y
CONFIG_NET_SOCKETS=y
CONFIG_NET_LOG=y
CONFIG_NET_IPV4=y
CONFIG_NET_UDP=y
CONFIG_NET_TCP=y

# Network buffer configuration
CONFIG_NET_PKT_RX_COUNT=16
CONFIG_NET_PKT_TX_COUNT=16
CONFIG_NET_BUF_RX_COUNT=32
CONFIG_NET_BUF_TX_COUNT=32
CONFIG_NRF70_RX_NUM_BUFS=16

# Wi-Fi memory configuration
# NOTE: P2P GO mode requires AP mode which needs more heap memory
CONFIG_HEAP_MEM_POOL_SIZE=80000
CONFIG_HEAP_MEM_POOL_IGNORE_MIN=y
CONFIG_NRF_WIFI_CTRL_HEAP_SIZE=40000
CONFIG_NRF_WIFI_DATA_HEAP_SIZE=100000
CONFIG_NET_TC_TX_COUNT=1

# Network interface configuration
CONFIG_NET_IF_UNICAST_IPV4_ADDR_COUNT=2
CONFIG_NET_MAX_CONTEXTS=10
CONFIG_NET_CONTEXT_SYNC_RECV=y

CONFIG_INIT_STACKS=y

# Ethernet L2
CONFIG_NET_L2_ETHERNET=y

# Zephyr NET Connection Manager (align with wifi shell behavior)
CONFIG_NET_CONNECTION_MANAGER=y
CONFIG_L2_WIFI_CONNECTIVITY=y
CONFIG_L2_WIFI_CONNECTIVITY_CONNECTION_PERSISTENCE=y
CONFIG_L2_WIFI_CONNECTIVITY_AUTO_CONNECT=y
CONFIG_L2_WIFI_CONNECTIVITY_AUTO_DOWN=n
CONFIG_NET_CONNECTION_MANAGER_MONITOR_STACK_SIZE=5000

# Wi-Fi credentials storage (required by L2 Wi-Fi connectivity)
CONFIG_WIFI_CREDENTIALS=y
CONFIG_WIFI_CREDENTIALS_CONNECT_STORED=y
CONFIG_FLASH=y
CONFIG_FLASH_PAGE_LAYOUT=y
CONFIG_FLASH_MAP=y
CONFIG_NVS=y
CONFIG_SETTINGS=y
CONFIG_SETTINGS_NVS=y

# Network configuration
# IMPORTANT: Disable auto init to prevent DHCP client from starting at boot
# This would interfere with P2P L2 packet operations (causes "Network interface is not configured" error)
# P2P will configure the interface dynamically - GO sets static IP, CLI runs DHCP after group forms
CONFIG_NET_CONFIG_SETTINGS=n

CONFIG_NET_SOCKETS_POLL_MAX=12

# Stack sizes
CONFIG_MAIN_STACK_SIZE=5200
CONFIG_NET_TX_STACK_SIZE=4096
CONFIG_NET_RX_STACK_SIZE=4096
CONFIG_P2P_SAMPLE_START_WIFI_THREAD_STACK_SIZE=5200

# GPIO and buttons
CONFIG_GPIO=y
CONFIG_DK_LIBRARY=y

# Debugging
CONFIG_STACK_SENTINEL=y
CONFIG_DEBUG_COREDUMP=y
CONFIG_DEBUG_COREDUMP_BACKEND_LOGGING=y
CONFIG_DEBUG_COREDUMP_MEMORY_DUMP_MIN=y

# Kernel options
CONFIG_ENTROPY_GENERATOR=y
CONFIG_REBOOT=y

# Logging
CONFIG_LOG=y
CONFIG_LOG_BUFFER_SIZE=4096
CONFIG_PRINTK=y
CONFIG_SHELL=y
CONFIG_NET_SHELL=y
CONFIG_WIFI_NM_WPA_SUPPLICANT_LOG_LEVEL_INF=y

# Timing
CONFIG_POSIX_TIMERS=y

# Net management event queue
CONFIG_NET_MGMT_EVENT_QUEUE_TIMEOUT=5000
CONFIG_NET_MGMT_EVENT_QUEUE_SIZE=16

# P2P specific configurations
CONFIG_WIFI_P2P_MAX_PEERS=5

# LTO and optimization for P2P
CONFIG_LTO=y
CONFIG_ISR_TABLES_LOCAL_DECLARATION=y

# UDP Echo Demo configuration
CONFIG_UDP_ECHO_COUNT=10

# POSIX API for socket operations
CONFIG_POSIX_API=y


# Enable DHCP client for P2P Client role
CONFIG_NET_DHCPV4=y
```

## overlay-p2p-cli.conf
```kconfig
#
# Copyright (c) 2026 Nordic Semiconductor ASA
#
# SPDX-License-Identifier: LicenseRef-Nordic-5-Clause
#
# Overlay for device that should always become Client (CLI)
#
# Usage: Build with -DEXTRA_CONF_FILE="overlay-p2p-cli.conf"

# Target peer MAC address filter - only connect to GO with this MAC
# Replace with your GO device's MAC address (found in terminal output)
# Leave empty to connect to any discovered peer
# Example: CONFIG_P2P_TARGET_PEER_MAC="f4:ce:36:00:af:12"
CONFIG_P2P_TARGET_PEER_MAC=""

# Low GO intent - always become Client
CONFIG_P2P_GO_INTENT=0

# Enable DHCP client to get IP from GO
CONFIG_NET_DHCPV4=y

# UDP Echo Count (set number of echo packets to send, 0 = infinite)
CONFIG_UDP_ECHO_COUNT=10
```

## overlay-p2p-go.conf
```kconfig
#
# Copyright (c) 2026 Nordic Semiconductor ASA
#
# SPDX-License-Identifier: LicenseRef-Nordic-5-Clause
#
# Overlay for device that should always become Group Owner (GO)
#
# Usage: Build with -DEXTRA_CONF_FILE="overlay-p2p-go.conf"

# High GO intent - always become GO
CONFIG_P2P_GO_INTENT=15

# GO IP configuration
CONFIG_P2P_GO_IP_ADDRESS="192.168.88.1"
CONFIG_P2P_GO_IP_NETMASK="255.255.255.0"
CONFIG_P2P_DHCP_SERVER_POOL_START="192.168.88.10"

# Target peer MAC (leave empty to connect to any discovered peer)
# Replace with your Client device's MAC address if you want strict pairing
# Example: CONFIG_P2P_TARGET_PEER_MAC="f4:ce:36:00:ae:ec"
CONFIG_P2P_TARGET_PEER_MAC=""

# UDP Echo Count (0 = infinite, or set a specific number)
CONFIG_UDP_ECHO_COUNT=0
```

## boards/nrf54lm20dk_nrf54lm20a_cpuapp.conf
```kconfig
#
# Copyright (c) 2026 Nordic Semiconductor ASA
#
# SPDX-License-Identifier: LicenseRef-Nordic-5-Clause
#
# Board-specific configuration for nRF54LM20 DK

# DK Library for buttons and LEDs
CONFIG_DK_LIBRARY=y

# Additional memory for P2P GO mode (AP mode requires more memory)
CONFIG_HEAP_MEM_POOL_SIZE=80000
CONFIG_NRF_WIFI_CTRL_HEAP_SIZE=40000
CONFIG_NRF_WIFI_DATA_HEAP_SIZE=100000
```

## src/main.c
```c
/*
 * Copyright (c) 2026 Nordic Semiconductor ASA
 *
 * SPDX-License-Identifier: LicenseRef-Nordic-5-Clause
 */

/** @file
 * @brief Nordic Wi-Fi Direct P2P Simple Connection Demo
 *
 * This application demonstrates Wi-Fi Direct (P2P) connection between two
 * Nordic devices. Press Button 1 simultaneously on both devices to initiate
 * pairing. One device will become the Group Owner (GO), the other will be
 * the Client (CLI).
 *
 * After connection:
 * - GO runs UDP echo server on port 5001
 * - Client sends UDP packets to GO and receives echo responses
 */

#include <zephyr/logging/log.h>
LOG_MODULE_REGISTER(main, CONFIG_LOG_DEFAULT_LEVEL);

#include <zephyr/kernel.h>
#include <zephyr/net/net_if.h>
#include <zephyr/net/wifi_mgmt.h>
#include <zephyr/net/net_event.h>
#include <zephyr/net/dhcpv4.h>
#include <zephyr/net/socket.h>
#include <dk_buttons_and_leds.h>
#include <stdio.h>

#include <net/wifi_ready.h>

#include "wifi_p2p_utils.h"
#include "net_utils.h"
#include "udp_utils.h"

/* Helper function to format MAC address as string */
static inline char *format_mac_addr(const uint8_t *mac, char *buf, size_t buf_len)
{
	snprintf(buf, buf_len, "%02x:%02x:%02x:%02x:%02x:%02x",
		 mac[0], mac[1], mac[2], mac[3], mac[4], mac[5]);
	return buf;
}

/* LED definitions (board LEDs are LED0..LED3) */
#define LED_P2P_FINDING    DK_LED1
#define LED_P2P_CONNECTED  DK_LED2
#define LED_GO_ROLE        DK_LED3
#define LED_CLI_ROLE       DK_LED4

/* Button definitions */
#define BUTTON_P2P_START   DK_BTN1_MSK
#define BUTTON_STOP_ECHO   DK_BTN2_MSK

/* Thread stack sizes */
#define UDP_ECHO_STACK_SIZE 4096

/* Work queue for P2P operations */
static struct k_work p2p_start_work;
static struct k_work p2p_connect_work;

/* Wi-Fi ready semaphore */
static K_SEM_DEFINE(wifi_ready_sem, 0, 1);
static bool wifi_ready_status;

/* P2P discovery result storage */
static struct wifi_p2p_device_info discovered_peers[CONFIG_WIFI_P2P_MAX_PEERS];
static uint16_t discovered_peer_count;

/* Connection state */
static bool p2p_pairing_in_progress;

/* DHCP bound handling (CLI) */
static struct k_work dhcp_bound_work;
static struct net_if *dhcp_bound_iface;
static bool dhcp_bound_handled;

/* LED blink work */
static struct k_work_delayable led_blink_work;
static bool led_blink_state;

/* UDP Echo state */
static int udp_socket = -1;
static struct sockaddr_in server_addr;
static volatile bool udp_echo_stop_flag;
static struct udp_echo_stats echo_stats;

/* UDP Echo threads */
static K_THREAD_STACK_DEFINE(udp_server_stack, UDP_ECHO_STACK_SIZE);
static struct k_thread udp_server_thread;
static k_tid_t udp_server_tid;

static K_THREAD_STACK_DEFINE(udp_client_stack, UDP_ECHO_STACK_SIZE);
static struct k_thread udp_client_thread;
static k_tid_t udp_client_tid;

/* Forward declarations */
static void udp_echo_server_thread_fn(void *p1, void *p2, void *p3);
static void udp_echo_client_thread_fn(void *p1, void *p2, void *p3);
static void start_udp_echo_client(const char *server_ip);

static void led_blink_handler(struct k_work *work)
{
	struct wifi_p2p_context *ctx = wifi_p2p_get_context();
	bool should_blink = p2p_pairing_in_progress ||
			    ctx->state == WIFI_P2P_STATE_FINDING ||
			    ctx->state == WIFI_P2P_STATE_CONNECTING;

	if (should_blink) {
		led_blink_state = !led_blink_state;
		dk_set_led(LED_P2P_FINDING, led_blink_state);
		k_work_schedule(&led_blink_work, K_MSEC(250));
	} else {
		dk_set_led(LED_P2P_FINDING, 0);
	}
}

static void dhcp_bound_handler(struct k_work *work)
{
	struct net_if *iface = dhcp_bound_iface;

	if (!iface) {
		return;
	}

	LOG_INF("IP address obtained from DHCP");
	net_utils_print_status(iface);

	/* Give GO some time to start its echo server */
	k_sleep(K_MSEC(CONFIG_P2P_CLIENT_CONNECT_DELAY_MS));

	/* Start UDP echo client - connect to GO's IP */
	start_udp_echo_client(CONFIG_P2P_GO_IP_ADDRESS);
}

static void dhcp_bound_cb(struct net_if *iface)
{
	if (dhcp_bound_handled) {
		return;
	}

	dhcp_bound_handled = true;
	dhcp_bound_iface = iface;
	k_work_submit(&dhcp_bound_work);
}

static void update_leds(void)
{
	struct wifi_p2p_context *ctx = wifi_p2p_get_context();

	/* Update connection LED */
	dk_set_led(LED_P2P_CONNECTED, ctx->connected ? 1 : 0);

	/* Update role LEDs */
	if (ctx->role == WIFI_P2P_ROLE_GO) {
		dk_set_led(LED_GO_ROLE, 1);
		dk_set_led(LED_CLI_ROLE, 0);
	} else if (ctx->role == WIFI_P2P_ROLE_CLI) {
		dk_set_led(LED_GO_ROLE, 0);
		dk_set_led(LED_CLI_ROLE, 1);
	} else {
		dk_set_led(LED_GO_ROLE, 0);
		dk_set_led(LED_CLI_ROLE, 0);
	}
}

static void start_udp_echo_server(void)
{
	int ret;

	LOG_INF("Starting UDP Echo Server on port %d...", CONFIG_UDP_ECHO_PORT);

	/* Initialize UDP server */
	ret = udp_server_init(&udp_socket, CONFIG_UDP_ECHO_PORT);
	if (ret < 0) {
		LOG_ERR("Failed to initialize UDP server: %d", ret);
		return;
	}

	/* Reset stats and stop flag */
	udp_echo_reset_stats(&echo_stats);
	udp_echo_stop_flag = false;

	/* Create and start UDP server thread */
	udp_server_tid = k_thread_create(&udp_server_thread,
					 udp_server_stack,
					 K_THREAD_STACK_SIZEOF(udp_server_stack),
					 udp_echo_server_thread_fn,
					 NULL, NULL, NULL,
					 K_PRIO_PREEMPT(8), 0, K_NO_WAIT);

	k_thread_name_set(udp_server_tid, "udp_echo_server");

	LOG_INF("UDP Echo Server started!");
	LOG_INF("Waiting for Client to send packets...");
}

static void start_udp_echo_client(const char *server_ip)
{
	int ret;

	LOG_INF("Starting UDP Echo Client...");
	LOG_INF("Target: %s:%d", server_ip, CONFIG_UDP_ECHO_PORT);

	/* Initialize UDP client */
	ret = udp_client_init(&udp_socket, &server_addr, server_ip,
			      CONFIG_UDP_ECHO_PORT);
	if (ret < 0) {
		LOG_ERR("Failed to initialize UDP client: %d", ret);
		return;
	}

	/* Reset stats and stop flag */
	udp_echo_reset_stats(&echo_stats);
	udp_echo_stop_flag = false;

	/* Create and start UDP client thread */
	udp_client_tid = k_thread_create(&udp_client_thread,
					 udp_client_stack,
					 K_THREAD_STACK_SIZEOF(udp_client_stack),
					 udp_echo_client_thread_fn,
					 NULL, NULL, NULL,
					 K_PRIO_PREEMPT(8), 0, K_NO_WAIT);

	k_thread_name_set(udp_client_tid, "udp_echo_client");

	LOG_INF("UDP Echo Client started!");
}

static void stop_udp_echo(void)
{
	LOG_INF("Stopping UDP Echo...");

	/* Set stop flag */
	udp_echo_stop_flag = true;

	/* Wait a bit for threads to exit */
	k_sleep(K_MSEC(500));

	/* Close socket */
	if (udp_socket >= 0) {
		udp_client_cleanup(udp_socket);
		udp_socket = -1;
	}

	/* Print final statistics */
	udp_echo_print_stats(&echo_stats);

	LOG_INF("UDP Echo stopped");
}

static void udp_echo_server_thread_fn(void *p1, void *p2, void *p3)
{
	ARG_UNUSED(p1);
	ARG_UNUSED(p2);
	ARG_UNUSED(p3);

	udp_echo_server_run(udp_socket, &echo_stats, &udp_echo_stop_flag);
}

static void udp_echo_client_thread_fn(void *p1, void *p2, void *p3)
{
	ARG_UNUSED(p1);
	ARG_UNUSED(p2);
	ARG_UNUSED(p3);

	udp_echo_client_run(udp_socket, &server_addr,
			    CONFIG_UDP_ECHO_PACKET_SIZE,
			    CONFIG_UDP_ECHO_INTERVAL_MS,
			    CONFIG_UDP_ECHO_COUNT,
			    &echo_stats, &udp_echo_stop_flag);

	/* Print stats when done */
	udp_echo_print_stats(&echo_stats);
}

static void setup_go_network(void)
{
	struct net_if *iface = net_utils_get_wifi_iface();
	int ret;

	/* Configure GO network AFTER P2P group is formed.
	 * This follows the same pattern as the wifi shell sample:
	 * 1. P2P connect completes
	 * 2. Manually configure IP with 'net ipv4 add'
	 * 3. Start DHCP server
	 */
	LOG_INF("Configuring GO network...");

	/* Configure IP address for GO */
	ret = net_utils_configure_go_ip(iface,
					CONFIG_P2P_GO_IP_ADDRESS,
					CONFIG_P2P_GO_IP_NETMASK);
	if (ret < 0) {
		LOG_ERR("Failed to configure GO IP: %d", ret);
	}

	/* Start DHCP server */
	ret = net_utils_start_dhcp_server(iface,
					  CONFIG_P2P_DHCP_SERVER_POOL_START);
	if (ret < 0) {
		LOG_ERR("Failed to start DHCP server: %d", ret);
	}

	LOG_INF("=================================");
	LOG_INF("Group Owner network ready!");
	LOG_INF("GO IP: %s", CONFIG_P2P_GO_IP_ADDRESS);
	LOG_INF("DHCP Pool: %s", CONFIG_P2P_DHCP_SERVER_POOL_START);
	LOG_INF("=================================");

	net_utils_print_status(iface);

	/* Start UDP echo server */
	start_udp_echo_server();
}

static void p2p_connect_handler(struct k_work *work)
{
	struct wifi_p2p_context *ctx = wifi_p2p_get_context();
	struct wifi_p2p_device_info *target_peer;
	int ret;

	if (discovered_peer_count == 0) {
		LOG_WRN("No peers discovered, cannot connect");
		p2p_pairing_in_progress = false;
		return;
	}

	/* Stop discovery before connecting */
	wifi_p2p_stop_find();

	/* Allow time for P2P-FIND-STOPPED before connecting */
	LOG_INF("Waiting for P2P-FIND-STOPPED...");
	k_sleep(K_MSEC(CONFIG_P2P_FIND_STOP_DELAY_MS));

	/* Find peer by MAC filter (if configured). Otherwise use highest RSSI. */
	if (CONFIG_P2P_TARGET_PEER_MAC[0] == '\0') {
		int best_idx = -1;
		int best_rssi = INT_MIN;

		if (discovered_peer_count > 1) {
			LOG_WRN("Multiple P2P peers found. Auto-selecting highest RSSI; set CONFIG_P2P_TARGET_PEER_MAC to force a specific peer.");
		}

		for (int i = 0; i < discovered_peer_count; i++) {
			if (discovered_peers[i].rssi > best_rssi) {
				best_rssi = discovered_peers[i].rssi;
				best_idx = i;
			}
		}

		target_peer = (best_idx >= 0) ? &discovered_peers[best_idx] : NULL;
	} else {
		target_peer = wifi_p2p_find_peer_by_mac(discovered_peers,
							discovered_peer_count,
							CONFIG_P2P_TARGET_PEER_MAC);
	}
	if (!target_peer) {
		char mac_str[sizeof("xx:xx:xx:xx:xx:xx")];

		LOG_ERR("No peer found matching MAC filter: '%s'", CONFIG_P2P_TARGET_PEER_MAC);
		LOG_INF("Available peers:");
		for (int i = 0; i < discovered_peer_count; i++) {
			LOG_INF("  [%d] %s", i,
				format_mac_addr(discovered_peers[i].mac, mac_str, sizeof(mac_str)));
		}
		p2p_pairing_in_progress = false;
		return;
	}

	uint8_t *peer_mac = target_peer->mac;
	uint8_t go_intent = CONFIG_P2P_GO_INTENT;
	uint32_t freq = CONFIG_P2P_OPERATING_FREQUENCY;

	LOG_INF("Attempting P2P connection with peer...");
	LOG_INF("Peer: %s", target_peer->device_name);
	LOG_INF("GO Intent: %d (15=GO, 0=Client)", go_intent);

	/* If we are CLI, wait for GO negotiation request before connecting.
	 * The wifi shell shows P2P-GO-NEG-REQUEST before the CLI initiates
	 * wifi p2p connect. This delay mirrors that sequence.
	 */
	if (go_intent == 0) {
		LOG_INF("Waiting for GO negotiation request...");
		k_sleep(K_MSEC(CONFIG_P2P_GO_NEG_REQUEST_WAIT_MS));
	}

	/* NOTE: Do NOT configure IP or call net_if_up() before P2P connect!
	 * The P2P subsystem manages the interface state internally.
	 * Interfering with interface state before P2P can cause WPS to fail.
	 * 
	 * The wifi shell sample works by NOT configuring anything before
	 * wifi p2p connect - IP is configured manually AFTER the P2P group forms.
	 */

	ret = wifi_p2p_connect(peer_mac, go_intent, freq);
	if (ret < 0) {
		LOG_ERR("P2P connect failed: %d", ret);
		p2p_pairing_in_progress = false;
		return;
	}

	/* Wait for P2P group formation (event-driven) */
	LOG_INF("Waiting for P2P group formation...");
	ret = wifi_p2p_wait_for_group_formation(CONFIG_P2P_GROUP_FORMATION_TIMEOUT_MS);
	if (ret < 0) {
		LOG_ERR("P2P group formation failed or timed out: %d", ret);
		p2p_pairing_in_progress = false;
		return;
	}

	/* Check the role we got from the negotiation */
	LOG_INF("P2P group formed!");
	LOG_INF("Role: %s", wifi_p2p_role_txt(ctx->role));

	/* Handle based on actual role (determined by negotiation) */
	if (ctx->role == WIFI_P2P_ROLE_GO) {
		/* We became Group Owner - wait for AP-STA-CONNECTED and 4-way handshake */
		LOG_INF("Waiting for AP-STA-CONNECTED...");
		ret = wifi_p2p_wait_for_ap_sta_connected(
			CONFIG_P2P_AP_STA_CONNECTED_TIMEOUT_MS);
		if (ret < 0) {
			LOG_WRN("AP-STA-CONNECTED not received, continuing anyway");
		}

		LOG_INF("Waiting for EAPOL 4-way handshake to complete...");
		k_sleep(K_MSEC(CONFIG_P2P_4WAY_HANDSHAKE_WAIT_MS));

		/* Now configure GO network and start DHCP server */
		setup_go_network();
	} else if (ctx->role == WIFI_P2P_ROLE_CLI) {
		/* We became Client - get IP from GO's DHCP server */
		struct net_if *iface = net_utils_get_wifi_iface();

		LOG_INF("P2P connection complete - starting DHCP client to get IP from GO...");

#if CONFIG_P2P_DHCP_START_DELAY_MS > 0
		/* Optional delay to wait for GO to start DHCP server */
		LOG_INF("Waiting %d ms for GO to start DHCP server...",
			CONFIG_P2P_DHCP_START_DELAY_MS);
		k_sleep(K_MSEC(CONFIG_P2P_DHCP_START_DELAY_MS));
#endif

		/* Register DHCP callback BEFORE starting DHCP client
		 * to ensure we don't miss the DHCP_BOUND event
		 */
		dhcp_bound_handled = false;
		dhcp_bound_iface = iface;
		net_utils_set_dhcp_bound_cb(dhcp_bound_cb);
		net_utils_register_dhcp_callback();

		/* Start DHCP client to get IP from GO */
		net_dhcpv4_start(iface);
		LOG_INF("DHCP client started - waiting for DHCP bound event...");
	} else {
		LOG_WRN("P2P role undetermined after connection");
	}

	wifi_p2p_print_status();
	update_leds();
	p2p_pairing_in_progress = false;
}

static void p2p_event_handler(enum wifi_p2p_event event, struct wifi_p2p_context *ctx)
{
	/* NOTE: Do NOT configure IP or DHCP in event handlers!
	 * The wifi shell works by configuring IP AFTER the P2P connection
	 * is fully established, not during the WPS handshake.
	 * Configuring during WPS can interfere with the handshake.
	 */
	switch (event) {
	case WIFI_P2P_EVENT_DEVICE_FOUND:
		LOG_INF("Event: P2P device found");
		break;
	case WIFI_P2P_EVENT_GROUP_STARTED:
		LOG_INF("Event: P2P group started (we are GO)");
		break;
	case WIFI_P2P_EVENT_CONNECTED:
		LOG_INF("Event: Connected to P2P group (we are Client)");
		break;
	case WIFI_P2P_EVENT_CONNECT_FAILED:
		LOG_ERR("Event: P2P connection failed");
		break;
	case WIFI_P2P_EVENT_PEER_JOINED:
		LOG_INF("Event: Peer joined our group");
		break;
	case WIFI_P2P_EVENT_AP_STA_CONNECTED:
		LOG_INF("Event: AP-STA-CONNECTED received");
		break;
	case WIFI_P2P_EVENT_PEER_LEFT:
		LOG_INF("Event: Peer left our group");
		stop_udp_echo();
		break;
	case WIFI_P2P_EVENT_DISCONNECTED:
		LOG_INF("Event: Disconnected from P2P group");
		stop_udp_echo();
		break;
	default:
		break;
	}

	/* Update LEDs based on current state */
	update_leds();
}

static void p2p_start_handler(struct k_work *work)
{
	struct wifi_p2p_context *ctx = wifi_p2p_get_context();
	int ret;

	if (p2p_pairing_in_progress) {
		LOG_WRN("P2P pairing already in progress");
		return;
	}

	p2p_pairing_in_progress = true;
	discovered_peer_count = 0;

	LOG_INF("========================================");
	LOG_INF("Starting Wi-Fi Direct P2P Pairing...");
	LOG_INF("GO Intent: %d (15=GO, 0=Client)", CONFIG_P2P_GO_INTENT);
	LOG_INF("Target MAC: %s", CONFIG_P2P_TARGET_PEER_MAC[0] ?
		CONFIG_P2P_TARGET_PEER_MAC : "(any peer)");
	LOG_INF("========================================");

	/* Start LED blinking */
	k_work_schedule(&led_blink_work, K_NO_WAIT);

	/* Start P2P discovery */
	ret = wifi_p2p_find(CONFIG_P2P_DISCOVERY_TIMEOUT);
	if (ret < 0) {
		LOG_ERR("Failed to start P2P discovery: %d", ret);
		p2p_pairing_in_progress = false;
		return;
	}

	/* Wait for peer discovery - use full timeout to find target peer
	 * In environments with multiple P2P devices, we need to wait long enough
	 * to discover the specific target peer, not just any peer.
	 */
	LOG_INF("Searching for P2P peers (waiting %d ms)...",
		CONFIG_P2P_DISCOVERY_WAIT_MS);

	/* Wait for the full discovery period */
	k_sleep(K_MSEC(CONFIG_P2P_DISCOVERY_WAIT_MS));

	/* Get discovered peers */
	ret = wifi_p2p_get_peers(discovered_peers, CONFIG_WIFI_P2P_MAX_PEERS,
				 &discovered_peer_count);
	if (ret < 0) {
		LOG_WRN("Failed to get peer list: %d", ret);
	}

	LOG_INF("Found %d P2P peer(s)", discovered_peer_count);

	/* Print discovered peers */
	for (int i = 0; i < discovered_peer_count; i++) {
		char mac_str[sizeof("xx:xx:xx:xx:xx:xx")];

		LOG_INF("Peer %d:", i + 1);
		LOG_INF("  Name: %s", discovered_peers[i].device_name);
		LOG_INF("  MAC: %s",
			format_mac_addr(discovered_peers[i].mac, mac_str, sizeof(mac_str)));
		LOG_INF("  RSSI: %d dBm", discovered_peers[i].rssi);
	}

	/* If peers found, initiate connection */
	if (discovered_peer_count > 0 || ctx->state == WIFI_P2P_STATE_FOUND) {
		LOG_INF("Peer found! Initiating connection...");
		k_work_submit(&p2p_connect_work);
	} else {
		LOG_INF("No peers found. Press BUTTON 0 on both devices simultaneously.");
		p2p_pairing_in_progress = false;
	}
}

static void button_handler(uint32_t button_state, uint32_t has_changed)
{
	if ((has_changed & BUTTON_P2P_START) && (button_state & BUTTON_P2P_START)) {
		struct wifi_p2p_context *ctx = wifi_p2p_get_context();

		if (!ctx->connected) {
			LOG_INF("BUTTON 0 pressed - Starting P2P pairing");
			k_work_submit(&p2p_start_work);
		} else {
			LOG_INF("BUTTON 0 pressed - Print UDP Echo stats");
			if (ctx->role == WIFI_P2P_ROLE_GO) {
				LOG_INF("GO is echo server only. Check CLI device for UDP Echo statistics.");
			} else {
				udp_echo_print_stats(&echo_stats);
			}
		}
	}

	if ((has_changed & BUTTON_STOP_ECHO) && (button_state & BUTTON_STOP_ECHO)) {
		LOG_INF("BUTTON 1 pressed - Stop UDP Echo");
		stop_udp_echo();
	}
}

static void wifi_ready_cb(bool ready)
{
	LOG_INF("Wi-Fi ready: %s", ready ? "yes" : "no");
	wifi_ready_status = ready;
	k_sem_give(&wifi_ready_sem);
}

static int register_wifi_ready(void)
{
	struct net_if *iface = net_if_get_first_wifi();
	wifi_ready_callback_t cb;
	int ret;

	if (!iface) {
		LOG_ERR("No Wi-Fi interface found");
		return -ENODEV;
	}

	cb.wifi_ready_cb = wifi_ready_cb;

	ret = register_wifi_ready_callback(cb, iface);
	if (ret) {
		LOG_ERR("Failed to register Wi-Fi ready callback: %d", ret);
		return ret;
	}

	return 0;
}

static int init_leds_and_buttons(void)
{
	int ret;

	ret = dk_leds_init();
	if (ret) {
		LOG_ERR("Failed to initialize LEDs: %d", ret);
		return ret;
	}

	ret = dk_buttons_init(button_handler);
	if (ret) {
		LOG_ERR("Failed to initialize buttons: %d", ret);
		return ret;
	}

	/* Turn off all LEDs initially */
	dk_set_leds(0);

	return 0;
}

void start_wifi_thread(void);

#define THREAD_PRIORITY K_PRIO_COOP(CONFIG_NUM_COOP_PRIORITIES - 1)
K_THREAD_DEFINE(start_wifi_thread_id, CONFIG_P2P_SAMPLE_START_WIFI_THREAD_STACK_SIZE,
		start_wifi_thread, NULL, NULL, NULL,
		THREAD_PRIORITY, 0, -1);

void start_wifi_thread(void)
{
	int ret;

	while (1) {
		LOG_INF("Waiting for Wi-Fi to be ready...");

		ret = k_sem_take(&wifi_ready_sem, K_FOREVER);
		if (ret) {
			LOG_ERR("Failed to wait for Wi-Fi ready: %d", ret);
			return;
		}

		if (!wifi_ready_status) {
			LOG_WRN("Wi-Fi not ready");
			continue;
		}

		LOG_INF("Wi-Fi is ready!");

		/* Initialize P2P subsystem */
		ret = wifi_p2p_init();
		if (ret) {
			LOG_ERR("Failed to initialize P2P: %d", ret);
			return;
		}

		/* Register P2P event callback */
		wifi_p2p_register_event_callback(p2p_event_handler);

		LOG_INF("============================================");
		LOG_INF("Nordic Wi-Fi Direct P2P Echo Demo Ready");
		LOG_INF("============================================");
		LOG_INF("");
		LOG_INF("Press BUTTON 0 to start P2P pairing");
		LOG_INF("Press on both devices simultaneously!");
		LOG_INF("");
		LOG_INF("After connection:");
		LOG_INF("  GO  -> UDP Echo Server on port %d", CONFIG_UDP_ECHO_PORT);
		LOG_INF("  CLI -> Sends packets, measures RTT");
		LOG_INF("");
		LOG_INF("BUTTON 0: Start pairing / Print stats");
		LOG_INF("BUTTON 1: Stop UDP Echo");
		LOG_INF("");
		LOG_INF("LED0: P2P Discovery (on during pairing)");
		LOG_INF("LED1: P2P Connected");
		LOG_INF("LED2: Group Owner (GO)");
		LOG_INF("LED3: Client (CLI)");
		LOG_INF("============================================");
		LOG_INF("");
		LOG_INF(">>> Please press BUTTON 0 on two devices at the same time to start pairing <<<");
		LOG_INF("");

		/* Keep running and wait for button press or Wi-Fi state change */
		ret = k_sem_take(&wifi_ready_sem, K_FOREVER);
		if (ret) {
			LOG_ERR("Failed to wait for Wi-Fi state: %d", ret);
			return;
		}
	}
}

int main(void)
{
	int ret;

	LOG_INF("Starting Nordic Wi-Fi Direct P2P Echo Demo");
	LOG_INF("Board: %s", CONFIG_BOARD);

	/* Initialize work items */
	k_work_init(&p2p_start_work, p2p_start_handler);
	k_work_init(&p2p_connect_work, p2p_connect_handler);
	k_work_init(&dhcp_bound_work, dhcp_bound_handler);
	k_work_init_delayable(&led_blink_work, led_blink_handler);

	/* Initialize LEDs and buttons */
	ret = init_leds_and_buttons();
	if (ret) {
		LOG_ERR("Failed to initialize LEDs and buttons: %d", ret);
		return ret;
	}

	/* Register Wi-Fi ready callback */
	ret = register_wifi_ready();
	if (ret) {
		LOG_ERR("Failed to register Wi-Fi ready callback: %d", ret);
		return ret;
	}

	/* Start Wi-Fi thread */
	k_thread_start(start_wifi_thread_id);

	return 0;
}
```

## src/net_utils.c
```c
/*
 * Copyright (c) 2026 Nordic Semiconductor ASA
 *
 * SPDX-License-Identifier: LicenseRef-Nordic-5-Clause
 */

#include <zephyr/logging/log.h>
LOG_MODULE_REGISTER(p2p_net_utils, CONFIG_LOG_DEFAULT_LEVEL);

#include <zephyr/kernel.h>
#include <zephyr/net/net_if.h>
#include <zephyr/net/net_mgmt.h>
#include <zephyr/net/wifi_mgmt.h>
#include <zephyr/net/dhcpv4_server.h>
#include <zephyr/net/net_event.h>
#include <stdio.h>

#include "net_utils.h"

/* Helper function to format MAC address as string */
static inline char *format_mac_addr(const uint8_t *mac, char *buf, size_t buf_len)
{
	snprintf(buf, buf_len, "%02x:%02x:%02x:%02x:%02x:%02x",
		 mac[0], mac[1], mac[2], mac[3], mac[4], mac[5]);
	return buf;
}

/* DHCP server status */
static bool dhcp_server_running;

/* DHCP bound semaphore */
static K_SEM_DEFINE(dhcp_bound_sem, 0, 1);

/* Network event callback */
static struct net_mgmt_event_callback net_mgmt_cb;
static net_utils_dhcp_bound_cb_t dhcp_bound_cb;

static void net_mgmt_event_handler(struct net_mgmt_event_callback *cb,
				   uint64_t mgmt_event, struct net_if *iface)
{
	switch (mgmt_event) {
	case NET_EVENT_IPV4_DHCP_BOUND:
		LOG_INF("DHCP bound - IP address obtained");
		k_sem_give(&dhcp_bound_sem);
		if (dhcp_bound_cb) {
			dhcp_bound_cb(iface);
		}
		break;
	default:
		break;
	}
}

struct net_if *net_utils_get_wifi_iface(void)
{
	return net_if_get_first_wifi();
}

int net_utils_configure_go_ip(struct net_if *iface, const char *ip_addr,
			      const char *netmask)
{
	struct in_addr addr;
	struct in_addr mask;
	int ret;

	if (!iface) {
		iface = net_if_get_first_wifi();
	}

	if (!iface) {
		LOG_ERR("No Wi-Fi interface found");
		return -ENODEV;
	}

	if (!ip_addr || !netmask) {
		LOG_ERR("Invalid IP address or netmask");
		return -EINVAL;
	}

	ret = net_addr_pton(AF_INET, ip_addr, &addr);
	if (ret < 0) {
		LOG_ERR("Invalid IP address format: %s", ip_addr);
		return ret;
	}

	ret = net_addr_pton(AF_INET, netmask, &mask);
	if (ret < 0) {
		LOG_ERR("Invalid netmask format: %s", netmask);
		return ret;
	}

	/* Add IP address to interface */
	struct net_if_addr *ifaddr;

	ifaddr = net_if_ipv4_addr_add(iface, &addr, NET_ADDR_MANUAL, 0);
	if (!ifaddr) {
		LOG_ERR("Failed to add IP address to interface");
		return -ENOMEM;
	}

	/* Set netmask */
	net_if_ipv4_set_netmask_by_addr(iface, &addr, &mask);

	char ip_str[NET_IPV4_ADDR_LEN];

	net_addr_ntop(AF_INET, &addr, ip_str, sizeof(ip_str));
	LOG_INF("Configured GO IP address: %s", ip_str);

	return 0;
}

int net_utils_start_dhcp_server(struct net_if *iface, const char *pool_start)
{
	struct in_addr pool_addr;
	int ret;

	if (!iface) {
		iface = net_if_get_first_wifi();
	}

	if (!iface) {
		LOG_ERR("No Wi-Fi interface found");
		return -ENODEV;
	}

	if (!pool_start) {
		LOG_ERR("Invalid DHCP pool start address");
		return -EINVAL;
	}

	ret = net_addr_pton(AF_INET, pool_start, &pool_addr);
	if (ret < 0) {
		LOG_ERR("Invalid DHCP pool address format: %s", pool_start);
		return ret;
	}

	ret = net_dhcpv4_server_start(iface, &pool_addr);
	if (ret == -EALREADY) {
		LOG_WRN("DHCP server already running");
		dhcp_server_running = true;
		return 0;
	} else if (ret < 0) {
		LOG_ERR("Failed to start DHCP server: %d", ret);
		return ret;
	}

	dhcp_server_running = true;
	LOG_INF("DHCP server started, pool starting at: %s", pool_start);

	return 0;
}

int net_utils_stop_dhcp_server(struct net_if *iface)
{
	int ret;

	if (!iface) {
		iface = net_if_get_first_wifi();
	}

	if (!iface) {
		LOG_ERR("No Wi-Fi interface found");
		return -ENODEV;
	}

	if (!dhcp_server_running) {
		LOG_WRN("DHCP server not running");
		return 0;
	}

	ret = net_dhcpv4_server_stop(iface);
	if (ret < 0) {
		LOG_ERR("Failed to stop DHCP server: %d", ret);
		return ret;
	}

	dhcp_server_running = false;
	LOG_INF("DHCP server stopped");

	return 0;
}

/* Flag to track if DHCP callback is registered */
static bool dhcp_cb_registered;

void net_utils_register_dhcp_callback(void)
{
	if (!dhcp_cb_registered) {
		/* Reset semaphore before registering callback to ensure clean state */
		k_sem_reset(&dhcp_bound_sem);

		net_mgmt_init_event_callback(&net_mgmt_cb, net_mgmt_event_handler,
					     NET_EVENT_IPV4_DHCP_BOUND);
		net_mgmt_add_event_callback(&net_mgmt_cb);
		dhcp_cb_registered = true;
		LOG_DBG("DHCP event callback registered");
	}
}

void net_utils_set_dhcp_bound_cb(net_utils_dhcp_bound_cb_t cb)
{
	dhcp_bound_cb = cb;
}

int net_utils_wait_for_dhcp(struct net_if *iface, uint32_t timeout_ms)
{
	int ret;

	if (!iface) {
		iface = net_if_get_first_wifi();
	}

	if (!iface) {
		LOG_ERR("No Wi-Fi interface found");
		return -ENODEV;
	}

	/* Ensure callback is registered */
	net_utils_register_dhcp_callback();

	LOG_INF("Waiting for DHCP to assign IP address...");

	ret = k_sem_take(&dhcp_bound_sem, K_MSEC(timeout_ms));
	if (ret == -EAGAIN) {
		LOG_ERR("DHCP timeout after %d ms", timeout_ms);
		return -ETIMEDOUT;
	}

	return 0;
}

void net_utils_print_status(struct net_if *iface)
{
	if (!iface) {
		iface = net_if_get_first_wifi();
	}

	if (!iface) {
		LOG_ERR("No Wi-Fi interface found");
		return;
	}

	LOG_INF("=== Network Status ===");

	/* Get and print IPv4 addresses */
	struct net_if_ipv4 *ipv4 = iface->config.ip.ipv4;

	if (ipv4) {
		for (int i = 0; i < NET_IF_MAX_IPV4_ADDR; i++) {
			if (ipv4->unicast[i].ipv4.is_used) {
				char ip_str[NET_IPV4_ADDR_LEN];
				char netmask_str[NET_IPV4_ADDR_LEN];

				net_addr_ntop(AF_INET,
					      &ipv4->unicast[i].ipv4.address.in_addr,
					      ip_str, sizeof(ip_str));
				net_addr_ntop(AF_INET,
					      &ipv4->unicast[i].netmask,
					      netmask_str, sizeof(netmask_str));
				LOG_INF("IPv4 Address: %s", ip_str);
				LOG_INF("Netmask: %s", netmask_str);
			}
		}

		char gw_str[NET_IPV4_ADDR_LEN];

		net_addr_ntop(AF_INET, &ipv4->gw, gw_str, sizeof(gw_str));
		LOG_INF("Gateway: %s", gw_str);
	} else {
		LOG_INF("No IPv4 configuration");
	}

	/* Print MAC address */
	struct net_linkaddr *linkaddr = net_if_get_link_addr(iface);

	if (linkaddr && linkaddr->len >= 6) {
		char mac_string_buf[sizeof("xx:xx:xx:xx:xx:xx")];

		LOG_INF("MAC Address: %s",
			format_mac_addr(linkaddr->addr, mac_string_buf, sizeof(mac_string_buf)));
	}

	LOG_INF("DHCP Server: %s", dhcp_server_running ? "Running" : "Stopped");
	LOG_INF("======================");
}
```

## src/net_utils.h
```c
/*
 * Copyright (c) 2026 Nordic Semiconductor ASA
 *
 * SPDX-License-Identifier: LicenseRef-Nordic-5-Clause
 */

#ifndef NET_UTILS_H_
#define NET_UTILS_H_

#include <zephyr/kernel.h>
#include <zephyr/net/net_if.h>

#ifdef __cplusplus
extern "C" {
#endif

/**
 * @brief Configure static IP address for GO role
 *
 * @param iface Network interface to configure
 * @param ip_addr IP address string (e.g., "192.168.88.1")
 * @param netmask Netmask string (e.g., "255.255.255.0")
 * @return 0 on success, negative error code on failure
 */
int net_utils_configure_go_ip(struct net_if *iface, const char *ip_addr,
			      const char *netmask);

/**
 * @brief Start DHCP server for P2P GO role
 *
 * @param iface Network interface to start DHCP server on
 * @param pool_start Start address of DHCP pool (e.g., "192.168.88.10")
 * @return 0 on success, negative error code on failure
 */
int net_utils_start_dhcp_server(struct net_if *iface, const char *pool_start);

/**
 * @brief Stop DHCP server
 *
 * @param iface Network interface
 * @return 0 on success, negative error code on failure
 */
int net_utils_stop_dhcp_server(struct net_if *iface);

/**
 * @brief Register DHCP event callback
 *
 * Should be called before starting DHCP client to ensure
 * the DHCP_BOUND event is not missed.
 */
void net_utils_register_dhcp_callback(void);

/**
 * @brief DHCP bound notification callback type
 *
 * @param iface Network interface where DHCP bound occurred
 */
typedef void (*net_utils_dhcp_bound_cb_t)(struct net_if *iface);

/**
 * @brief Set user callback for DHCP bound event
 *
 * @param cb Callback function (NULL to clear)
 */
void net_utils_set_dhcp_bound_cb(net_utils_dhcp_bound_cb_t cb);

/**
 * @brief Wait for DHCP client to obtain IP address
 *
 * @param iface Network interface
 * @param timeout_ms Timeout in milliseconds
 * @return 0 on success, negative error code on failure/timeout
 */
int net_utils_wait_for_dhcp(struct net_if *iface, uint32_t timeout_ms);

/**
 * @brief Print current network interface status
 *
 * @param iface Network interface (NULL for default Wi-Fi interface)
 */
void net_utils_print_status(struct net_if *iface);

/**
 * @brief Get the first Wi-Fi network interface
 *
 * @return Pointer to Wi-Fi network interface, or NULL if not found
 */
struct net_if *net_utils_get_wifi_iface(void);

#ifdef __cplusplus
}
#endif

#endif /* NET_UTILS_H_ */
```

## src/udp_utils.h
```c
/*
 * Copyright (c) 2026 Nordic Semiconductor ASA
 *
 * SPDX-License-Identifier: LicenseRef-Nordic-5-Clause
 */

#ifndef UDP_UTILS_H
#define UDP_UTILS_H

#include <zephyr/kernel.h>
#include <zephyr/net/socket.h>

#ifdef __cplusplus
extern "C" {
#endif

/** UDP Echo statistics */
struct udp_echo_stats {
	/** Total packets sent */
	uint32_t packets_sent;
	/** Total packets received */
	uint32_t packets_received;
	/** Total bytes sent */
	uint32_t bytes_sent;
	/** Total bytes received */
	uint32_t bytes_received;
	/** Packet loss count */
	uint32_t packets_lost;
	/** Minimum RTT in microseconds */
	uint32_t rtt_min_us;
	/** Maximum RTT in microseconds */
	uint32_t rtt_max_us;
	/** Average RTT in microseconds */
	uint32_t rtt_avg_us;
	/** Total RTT for averaging */
	uint64_t rtt_total_us;
};

/**
 * @brief Initialize UDP client
 *
 * @param socket Pointer to store the socket descriptor
 * @param server_addr Pointer to store the server address structure
 * @param target_ip Target IP address as string
 * @param port Target port number
 * @return 0 on success, negative error code on failure
 */
int udp_client_init(int *socket, struct sockaddr_in *server_addr,
		    const char *target_ip, uint16_t port);

/**
 * @brief Initialize UDP server (echo server)
 *
 * @param socket Pointer to store the socket descriptor
 * @param port Port number to listen on
 * @return 0 on success, negative error code on failure
 */
int udp_server_init(int *socket, uint16_t port);

/**
 * @brief Send UDP packet
 *
 * @param socket Socket descriptor
 * @param server_addr Server address structure
 * @param data Data to send
 * @param data_len Length of data to send
 * @return Number of bytes sent on success, negative error code on failure
 */
int udp_send(int socket, struct sockaddr_in *server_addr,
	     const char *data, size_t data_len);

/**
 * @brief Receive UDP packet
 *
 * @param socket Socket descriptor
 * @param buffer Buffer to store received data
 * @param buffer_size Size of the buffer
 * @param client_addr Pointer to store client address (can be NULL)
 * @return Number of bytes received on success, negative error code on failure
 */
int udp_receive(int socket, char *buffer, size_t buffer_size,
		struct sockaddr_in *client_addr);

/**
 * @brief Send UDP packet and receive echo response (with RTT measurement)
 *
 * @param socket Socket descriptor
 * @param server_addr Server address structure
 * @param data Data to send
 * @param data_len Length of data to send
 * @param recv_buffer Buffer for received echo data
 * @param recv_buffer_size Size of receive buffer
 * @param rtt_us Output: Round-trip time in microseconds
 * @return Number of bytes received on success, negative error code on failure
 */
int udp_echo_ping(int socket, struct sockaddr_in *server_addr,
		  const char *data, size_t data_len,
		  char *recv_buffer, size_t recv_buffer_size,
		  uint32_t *rtt_us);

/**
 * @brief Run UDP echo server (blocks and loops back packets)
 *
 * @param socket Server socket descriptor
 * @param stats Pointer to statistics structure (can be NULL)
 * @param stop_flag Pointer to stop flag (set to true to stop server)
 * @return 0 on success, negative error code on failure
 */
int udp_echo_server_run(int socket, struct udp_echo_stats *stats,
			volatile bool *stop_flag);

/**
 * @brief Run UDP echo client (sends packets and measures RTT)
 *
 * @param socket Client socket descriptor
 * @param server_addr Server address structure
 * @param packet_size Size of packets to send
 * @param interval_ms Interval between packets in milliseconds
 * @param count Number of packets to send (0 = infinite)
 * @param stats Pointer to statistics structure (can be NULL)
 * @param stop_flag Pointer to stop flag (set to true to stop client)
 * @return 0 on success, negative error code on failure
 */
int udp_echo_client_run(int socket, struct sockaddr_in *server_addr,
			size_t packet_size, uint32_t interval_ms,
			uint32_t count, struct udp_echo_stats *stats,
			volatile bool *stop_flag);

/**
 * @brief Cleanup UDP client
 *
 * @param socket Socket descriptor to close
 */
void udp_client_cleanup(int socket);

/**
 * @brief Cleanup UDP server
 *
 * @param socket Socket descriptor to close
 */
void udp_server_cleanup(int socket);

/**
 * @brief Print UDP echo statistics
 *
 * @param stats Pointer to statistics structure
 */
void udp_echo_print_stats(const struct udp_echo_stats *stats);

/**
 * @brief Reset UDP echo statistics
 *
 * @param stats Pointer to statistics structure
 */
void udp_echo_reset_stats(struct udp_echo_stats *stats);

#ifdef __cplusplus
}
#endif

#endif /* UDP_UTILS_H */
```
